## drivers/i2s/Kconfig.max32
```kconfig
# Copyright (c) 2025 Croxel Inc.
# SPDX-License-Identifier: Apache-2.0

config I2S_MAX32
	bool "Analog Devices MAX32 series I2S driver"
	default y
	depends on DT_HAS_ADI_MAX32_I2S_ENABLED
	select DMA
	help
	  Enable support for Analog Devices MAX32 series I2S driver.
	  
if I2S_MAX32

config I2S_MAX32_RX_BLOCK_COUNT
	int "RX queue length"
	default 4
	help
	  Number of blocks in the RX queue. Each block has the size
	  specified by the I2S client.

config I2S_MAX32_TX_BLOCK_COUNT  
	int "TX queue length"
	default 4
	help
	  Number of blocks in the TX queue. Each block has the size
	  specified by the I2S client.

endif # I2S_MAX32
```

## dts/bindings/i2s/adi,max32-i2s.yaml
```yaml
# Copyright (c) 2025 Croxel Inc.
# SPDX-License-Identifier: Apache-2.0

description: Analog Devices MAX3 series I2S controller

compatible: "adi,max32-i2s"

include: [i2s-controller.yaml, pinctrl-device.yaml]

properties:
  reg:
    required: true

  dmas:
    required: true
    description: |
      DMA channels for RX and TX. Two channels must be provided in the following order:
      - RX DMA channel
      - TX DMA channel

  dma-names:
    required: true
    description: |
      Names of DMA channels for RX and TX. Must be provided in the following order:
      - rx
      - tx

  pinctrl-0:
    required: true
    description: |
      GPIO pin configuration for I2S signals. The required signals are:
      - I2S_WS (Word Select/Frame sync)
      - I2S_SCK (Bit clock) 
      - I2S_SDO (Serial data output)
      - I2S_SDI (Serial data input)

  pinctrl-names:
    required: true
```

## dts/bindings/led/ti,lp5521.yaml
```yaml
description: TI LP5521 LED

compatible: "ti,lp5521"

include: ti,lp55xx.yaml

properties:
  charge-pump-mode:
    type: int
    default: 3
    enum:
      - 0
      - 1
      - 2
      - 3
    description: configure charge-pump mode, 0=>off, 1=>1x, 2=>1.5x, 3=>auto

  red-charge-pump-bypass:
    type: boolean
    description: bypass charge-pump for reg led, and connect it directly to batt
```

## dts/bindings/led/ti,lp55xx.yaml
```yaml
# Copyright (c) 2024 Croxel Inc
# SPDX-License-Identifier: Apache-2.0

include: ["i2c-device.yaml", "led-controller.yaml"]

properties:
  red-output-current:
    type: int
    default: 175
    description: Output current of red channel in 0.1 mA (0-25.5 mA).
                 Default value is the power-on default. Valid range = 0 - 255

  green-output-current:
    type: int
    default: 175
    description: Output current of green channel in 0.1 mA (0-25.5 mA)
                 Default value is the power-on default. Valid range = 0 - 255

  blue-output-current:
    type: int
    default: 175
    description: Output current of blue channel in 0.1 mA (0-25.5 mA)
                 Default value is the power-on default. Valid range = 0 - 255

  clk-sel:
    type: int
    default: 3
    enum:
      - 0
      - 1
      - 2
      - 3
    description: select clock 0 => external, 1/3 => internal, 2=> auto-detect

  hf-pwm-dis:
    type: boolean
    description: Enable high frequency pwm

  power-save-dis:
    type: boolean
    description: Enable power save mode

  en-gpios:
    type: phandle-array
    description: |
      GPIO to enable LP55XX (both Charge-pump and Digital Communications interface).
      If not provided, user must ensure enable pin is already asserted externally (e.g:
      pull-up resistor).

  log-scale-en:
    type: boolean
    description: |
      Use logarithmic scale for pwm values instead of default linear scaling

  active-low:
    type: boolean
    description: |
      Are led's connected in active low or active high
```

## dts/bindings/led_strip/worldsemi,ws2812-uart.yaml
```yaml
description: |
  Worldsemi WS2812 LED strip, UART binding

  Driver bindings for controlling a WS2812 or compatible LED
  strip with a Uart.

  The Uart driver should be usable as long as a zephyr Uart API driver
  is available for your board. Hardware specific tuning is required
  using these properties:

    - uart-baudrate

  Use of this driver implies an 8x internal memory overhead (1 byte of
  driver RAM overhead per bit of pixel data).

compatible: "worldsemi,ws2812-uart"

include: [uart-controller.yaml, ws2812.yaml]
```

## samples/drivers/i2s/output/Kconfig
```kconfig
# Copyright (c) 2021 Nordic Semiconductor ASA
# SPDX-License-Identifier: Apache-2.0

source "Kconfig.zephyr"

config I2C
	default $(dt_compat_on_bus,$(DT_COMPAT_ADI_MAX9867),i2c)

config SINE_WAVE_PLAYBACK_DURATION_MS
	int "Sine wave playback duration (milliseconds)"
	default 2000
	help
	  Duration of the sine wave playback in milliseconds.
```
