## boards/croxel/croxel_cx1827/Kconfig.sysbuild
```kconfig
# Copyright (c) 2025 Nordic Semiconductor ASA
# SPDX-License-Identifier: Apache-2.0

if BOARD_CROXEL_CX1827_NRF54H20_CPURAD

config NRF_DEFAULT_EMPTY
	default y

endif # BOARD_CROXEL_CX1827_NRF54H20_CPURAD
```

## boards/croxel/croxel_cx1827/board.yml
```yaml
board:
  name: croxel_cx1827
  full_name: Croxel CX1827
  vendor: croxel
  socs:
  - name: nrf54h20
    variants:
    - name: xip
      cpucluster: cpuppr
    - name: xip
      cpucluster: cpuflpr
runners:
  run_once:
    '--recover':
    - runners:
      - nrfutil
      run: first
      groups:
      - boards:
        - croxel_cx1827/nrf54h20/cpuapp
        - croxel_cx1827/nrf54h20/cpurad
        - croxel_cx1827/nrf54h20/cpuppr
        - croxel_cx1827/nrf54h20/cpuppr/xip
        - croxel_cx1827/nrf54h20/cpuflpr
        - croxel_cx1827/nrf54h20/cpuflpr/xip
    '--erase':
    - runners:
      - jlink
      - nrfutil
      run: first
      groups:
      - boards:
        - croxel_cx1827/nrf54h20/cpuapp
        - croxel_cx1827/nrf54h20/cpurad
        - croxel_cx1827/nrf54h20/cpuppr
        - croxel_cx1827/nrf54h20/cpuppr/xip
        - croxel_cx1827/nrf54h20/cpuflpr
        - croxel_cx1827/nrf54h20/cpuflpr/xip
    '--reset':
    - runners:
      - jlink
      - nrfutil
      run: last
      groups:
      - boards:
        - croxel_cx1827/nrf54h20/cpuapp
        - croxel_cx1827/nrf54h20/cpurad
        - croxel_cx1827/nrf54h20/cpuppr
        - croxel_cx1827/nrf54h20/cpuppr/xip
        - croxel_cx1827/nrf54h20/cpuflpr
        - croxel_cx1827/nrf54h20/cpuflpr/xip
```

## boards/croxel/croxel_cx1827/croxel_cx1827_nrf54h20_cpuapp_defconfig
```kconfig
# Copyright (c) 2024 Nordic Semiconductor ASA
# SPDX-License-Identifier: Apache-2.0

# Enable UART driver
CONFIG_SERIAL=y

# Enable console
CONFIG_CONSOLE=y
CONFIG_UART_CONSOLE=y

# Enable MPU
CONFIG_ARM_MPU=y

# MPU-based null-pointer dereferencing detection cannot be applied
# as the (0x0 - 0x400) region is unmapped for this target.
CONFIG_NULL_POINTER_EXCEPTION_DETECTION_NONE=y

# Enable cache
CONFIG_CACHE_MANAGEMENT=y
CONFIG_EXTERNAL_CACHE=y

# Enable GPIO
CONFIG_GPIO=y
CONFIG_I2C=y
CONFIG_PWM=y

CONFIG_SOC_NRF54H20_GENERATE_BICR=y

# Enable logging
CONFIG_LOG=y

# USB Next Configuration
CONFIG_UDC_DRIVER_LOG_LEVEL_WRN=y
CONFIG_USBD_NEXT_INIT_ON_BOOT=y
CONFIG_USBD_LOG_LEVEL_WRN=y
CONFIG_USBD_CDC_ACM_CLASS=y
CONFIG_USBD_CDC_ACM_LOG_LEVEL_ERR=y
CONFIG_SAMPLE_USBD_PID=0x0001
CONFIG_SAMPLE_USBD_MANUFACTURER="Croxel"
CONFIG_SAMPLE_USBD_PRODUCT="CX1827"
```
